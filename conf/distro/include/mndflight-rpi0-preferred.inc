## conf/distro/mndflight-rpi0.conf
```bitbake
require conf/distro/poky.conf
require conf/distro/include/mndflight-rpi0-preferred.inc

DISTRO = "mndflight-rpi0"
DISTRO_NAME = "Embedded Flight Controller (Based on Yocto Project)"
DISTRO_VERSION = "1.8"
DISTRO_CODENAME = "rocko"
SDK_VENDOR = "-mndflight"
SDK_VERSION := "${@'${DISTRO_VERSION}'.replace('snapshot-${DATE}','snapshot')}"

MAINTAINER = "Nicolas Said <nicolas.said@gmail.com>"

TARGET_VENDOR = "-mndflight"

LOCALCONF_VERSION = "1"
```

## conf/layer.conf
```bitbake
# We have a conf and classes directory, add to BBPATH
BBPATH .= ":${LAYERDIR}"

# We have recipes-* directories, add to BBFILES
BBFILES += "${LAYERDIR}/recipes-*/*/*.bb \
	${LAYERDIR}/recipes-*/*/*.bbappend"

BBFILE_COLLECTIONS += "mndflight"
BBFILE_PATTERN_mndflight = "^${LAYERDIR}/"
BBFILE_PRIORITY_mndflight = "20"

# LAYERDEPENDS_videoserver = "variscite-mx6 fsl-arm fsl-demos fsl-bsp-release \
#	networking-layer filesystems-layer qt5-layer"
```
